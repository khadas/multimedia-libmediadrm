## Config.in
```kconfig
menu "Media DRM Prebuilt"
source "../multimedia/libmediadrm/widevine-bin/Config.in"
source "../multimedia/libmediadrm/libsecmem-bin/Config.in"
source "../multimedia/libmediadrm/playready-bin/Config.in"
source "../multimedia/libmediadrm/youtubesign-bin/Config.in"
source "../multimedia/libmediadrm/libwfd_hdcp-bin/Config.in"
endmenu
```

## cleartvp-bin/Config.in
```kconfig
config BR2_PACKAGE_CLEARTVP_BIN
        bool "cleartvp"
        select BR2_PACKAGE_TDK
        help
          cleartvp prebuilt files.

          http://openlinux.amlogic.com
```

## libwfd_hdcp-bin/Config.in
```kconfig
config BR2_PACKAGE_LIBWFD_HDCP_BIN
        bool "libwfd_hdcp"
        select BR2_PACKAGE_TDK
        help
          libhdcp prebuilt files.

          http://openlinux.amlogic.com
```

## widevine-bin/Config.in
```kconfig
config BR2_PACKAGE_WIDEVINE_BIN
        bool "widevine prebuilt"
        select BR2_PACKAGE_TDK
        help
          widevine prebuilt files.

          http://openlinux.amlogic.com

config BR2_PACKAGE_WIDEVINE_BIN_VERSION
        string "widevine prebuilt version"
        default "10"
        depends on BR2_PACKAGE_WIDEVINE_BIN
        help
          widevine prebuilt version
```
